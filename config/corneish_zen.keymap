/* source key position labels */
#include "zmk-helpers/key-labels/42.h"

/* activate bluetooth */
#define CONFIG_WIRELESS 1

/* source the main keymap */
#include "base.keymap"

/{
    chosen {
        zmk,matrix_transform = &default_transform;
    };
};
